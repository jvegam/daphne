## FMC/boards/arm/nucleo_h743zi/Kconfig.defconfig
```kconfig
# STM32H743ZI Nucleo board configuration

# Copyright (c) 2020 Teslabs Engineering S.L.
# SPDX-License-Identifier: Apache-2.0

if BOARD_NUCLEO_H743ZI

config BOARD
	default "nucleo_h743zi"

config UART_2
	default y
	depends on UART_CONSOLE

config FMC_0
	default y
	depends on FMC

endif # BOARD_NUCLEO_H743ZI
```

## FMC/drivers/fmc/Kconfig
```kconfig
# FMC driver configuration options

# Copyright (c) 2020 Juan Vega <juan.vega25@gmail.com>
# SPDX-License-Identifier: Apache-2.0

#
# FMC Drivers
#
menuconfig FMC
	bool "FMC hardware bus support"
	help
	  Enable support for the FMC hardware bus.

if FMC

config FMC_INIT_PRIORITY
	int "Init priority"
	default 48
	help
	  Device driver initialization priority.

module = FMC
module-str = fmc
source "subsys/logging/Kconfig.template.log_config"

source "drivers/fmc/Kconfig.stm32"

endif # FMC
```

## FMC/drivers/fmc/Kconfig.stm32
```kconfig
# STM32 SPI driver configuration options

# Copyright (c) 2015-2016 Intel Corporation
# SPDX-License-Identifier: Apache-2.0

menuconfig FMC_STM32
	bool "STM32 MCU FMC controller driver"
	depends on SOC_FAMILY_STM32
	select USE_STM32_LL_FMC
	help
	  Enable FMC support on the STM32 family of processors.

if FMC_STM32

config FMC_0
	bool "FMC port 0"
	help
	  Enable FMC controller port 0.

endif # FMC_STM32
```

## FMC/dts/bindings/fmc/fmc-controller.yaml
```yaml
# Copyright (c) 2020, Juan Vega <juan.vega25@gmail.com>
# SPDX-License-Identifier: Apache-2.0

include: base.yaml

bus: fmc

properties:
    sram-handle-enable :
      type: array
      required: true
      description: Enable SRAM handle	
    data-width :
      type: int
      required: true
      description: Bus width 8, 16 or 32 bits
    address-width :
      type: int
      required: true
      description: Address width Max 26 bits
    async-wait-enable :
      type: array
      required: true
      description: Enable nwait signal out 0 or 1
```

## FMC/dts/bindings/fmc/st,stm32-fmc.yaml
```yaml
# Copyright (c) 2020, Juan Vega <juan.vega25@gmail.com>
# SPDX-License-Identifier: Apache-2.0

description: STM32 FMC

compatible: "st,stm32-fmc"

include: fmc-controller.yaml

properties:
    reg:
      required: true

    label:
      required: true
```
